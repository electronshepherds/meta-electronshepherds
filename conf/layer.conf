## conf/layer.conf
```bitbake
# We have a conf and classes directory, add to BBPATH
BBPATH .= ":${LAYERDIR}"

# We have recipes-* directories, add to BBFILES
BBFILES += "${LAYERDIR}/recipes-*/*/*.bb \
            ${LAYERDIR}/recipes-*/*/*.bbappend"

BBFILE_COLLECTIONS += "meta-electronshepherds"
BBFILE_PATTERN_meta-electronshepherds = "^${LAYERDIR}/"
BBFILE_PRIORITY_meta-electronshepherds = "6"

LAYERDEPENDS_meta-electronshepherds = "core"
LAYERSERIES_COMPAT_meta-electronshepherds = "honister"
```
